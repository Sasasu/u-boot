## configs/mangopi_dual_defconfig
```kconfig
CONFIG_ARM=y
CONFIG_ARCH_SUNXI=y
CONFIG_MACH_SUN8I_T113=y
CONFIG_DEFAULT_DEVICE_TREE="sun8i-t113-mangopi-dual"
CONFIG_SPL=y
CONFIG_SPL_SPI_SUNXI=y
CONFIG_SPL_SPI_SUNXI_NAND=y
# CONFIG_SPL_SPI_SUNXI_NOR is not set
# CONFIG_SPL_MMC is not set
# CONFIG_SPL_POWER is not set
CONFIG_ENV_IS_IN_MTD=y
CONFIG_ENV_SIZE=0x10000
CONFIG_ENV_RANGE=0x20000
CONFIG_ENV_OFFSET=0xc0000
CONFIG_ENV_OFFSET_REDUND=0xe0000
CONFIG_SYS_REDUNDAND_ENVIRONMENT=y
# CONFIG_HAS_ARMV7_SECURE_BASE is not set
CONFIG_SPL_STACK=0x28000
CONFIG_RGMII=y
CONFIG_SUN8I_EMAC=y
CONFIG_DM_ETH_PHY=y
# CONFIG_PHY_ADDR_ENABLE is not set
CONFIG_RTL83XX_SWITCH=y
# CONFIG_DISTRO_DEFAULTS is not set
CONFIG_SPI=y
CONFIG_SPI_SUNXI=y
CONFIG_MTD=y
CONFIG_DM_MTD=y
CONFIG_MTD_SPI_NAND=y
# CONFIG_SPI_FLASH is not set
CONFIG_FS_UBIFS=y
CONFIG_USB=y
CONFIG_DM_USB=y
CONFIG_USB_EHCI_HCD=y
CONFIG_USB_OHCI_HCD=y
CONFIG_USB_STORAGE=y
CONFIG_USB_MUSB_GADGET=y
CONFIG_USB_MUSB_SUNXI=y
CONFIG_USB_MUSB_DISABLE_BULK_COMBINE_SPLIT=y
CONFIG_USB_MUSB_PIO_ONLY=y
CONFIG_USB_MUSB_FIXED_CONFIGDATA=y
CONFIG_USB_GADGET_DUALSPEED=y
CONFIG_USB_GADGET_DOWNLOAD=y
CONFIG_USB_FUNCTION_MASS_STORAGE=y
# CONFIG_USB_FUNCTION_FASTBOOT is not set
# CONFIG_USB_ETHER is not set
CONFIG_MMC=y
CONFIG_MMC_HS400_SUPPORT=y
CONFIG_MMC_SUNXI=y
CONFIG_PARTITIONS=y
CONFIG_BLK=y
CONFIG_FS_EXT4=y
CONFIG_FS_FAT=y
CONFIG_BOOTCOUNT_LIMIT=y
CONFIG_BOOTCOUNT_ENV=y
CONFIG_HUSH_PARSER=y
CONFIG_CMD_USB=y
CONFIG_CMD_USB_MASS_STORAGE=y
CONFIG_CMD_FS_GENERIC=y
CONFIG_CMD_MII=y
CONFIG_CMD_PING=y
CONFIG_CMD_PART=y
CONFIG_CMD_MTD=y
CONFIG_CMD_MTDPARTS=y
# CONFIG_CMD_FLASH is not set
```
